/*
 * Copyright (c) 2022 The ZMK Contributors
 *
 * SPDX-License-Identifier: MIT
 */

#include "lotus58_ble.dtsi"

&default_transform {
  col-offset = <6>;
};

&kscan0 {
  gpios
    = <&gpio0 2  GPIO_ACTIVE_LOW> // pin 0
    , <&gpio0 24 GPIO_ACTIVE_LOW> // pin 5
    , <&gpio0 10 GPIO_ACTIVE_LOW> // pin 4
    , <&gpio0 9  GPIO_ACTIVE_LOW> // pin 3
    , <&gpio0 3  GPIO_ACTIVE_LOW> // pin 2
    , <&gpio0 28 GPIO_ACTIVE_LOW> // pin 1
    ;
};

&right_encoder {
    status = "okay";
};
