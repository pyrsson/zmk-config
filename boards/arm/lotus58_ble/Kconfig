## boards/arm/lotus58_ble/Kconfig
```kconfig
# SPDX-License-Identifier: MIT

if BOARD_LOTUS58_BLE_LEFT || BOARD_LOTUS58_BLE_RIGHT

config BOARD_ENABLE_DCDC
    bool "DCDC Mode"
    select SOC_DCDC_NRF52X
    default y

config BOARD_ENABLE_DCDC_HV
    bool "High Voltage DCDC Converter"
    select SOC_DCDC_NRF52X_HV
    default y

endif # BOARD_LOTUS58_BLE_LEFT || BOARD_LOTUS58_BLE_RIGHT
```

## boards/arm/lotus58_ble/Kconfig.board
```kconfig
# Lotus58 BLE board configuration

# Copyright (c) 2022 The ZMK Contributors
# SPDX-License-Identifier: MIT

config BOARD_LOTUS58_BLE
	bool "lotus58 ble"
	depends on SOC_NRF52840_QIAA

config BOARD_LOTUS58_BLE_RIGHT
	bool "lotus58 right"
	depends on SOC_NRF52840_QIAA

config BOARD_LOTUS58_BLE_LEFT
	bool "lotus58 left"
	depends on SOC_NRF52840_QIAA

config BOARD_LOTUS58_BLE_RESET
	bool "lotus58 reset"
	depends on SOC_NRF52840_QIAA
```

## boards/arm/lotus58_ble/Kconfig.defconfig
```kconfig
# Copyright (c) 2022 The ZMK Contributors
# SPDX-License-Identifier: MIT
 
if BOARD_LOTUS58_BLE_LEFT

config ZMK_KEYBOARD_NAME
	default "Lotus BLE"

config ZMK_SPLIT_BLE_ROLE_CENTRAL
	default y

endif

if BOARD_LOTUS58_BLE_LEFT || BOARD_LOTUS58_BLE_RIGHT

config BOARD
  default "lotus58_ble"

config BT_CTLR
	default BT

config ZMK_SPLIT
	default y

config ZMK_STUDIO
	default y

if USB

config USB_NRFX
	default y

config USB_DEVICE_STACK
	default y

endif # USB

if ZMK_DISPLAY

config SPI
    default y

config SPI_NRFX
    default y

config DISPLAY
    default y

config ZMK_DISPLAY_BLANK_ON_IDLE
    default n

endif # ZMK_DISPLAY

endif # BOARD_LOTUS58_BLE_LEFT || BOARD_LOTUS58_BLE_RIGHT
```

## boards/arm/lotus58_ble/lotus58_ble_left_defconfig
```kconfig
# SPDX-License-Identifier: MIT
# Enable deep sleep support (default n)
CONFIG_ZMK_SLEEP=y

CONFIG_SOC_SERIES_NRF52X=y
CONFIG_SOC_NRF52840_QIAA=y
CONFIG_BOARD_LOTUS58_BLE_LEFT=y

# Milliseconds of inactivity before entering deep sleep (default 900000)
CONFIG_ZMK_IDLE_SLEEP_TIMEOUT=2400000

# Enable MPU
CONFIG_ARM_MPU=y

# Use pinctrl
CONFIG_PINCTRL=y

# enable GPIO
CONFIG_GPIO=y

# # Increase the bluetooth transmission power
# CONFIG_BT_CTLR_TX_PWR_PLUS_8=y

# # Adjust the 32KHz clock accuracy to fix 0x08 timeout disconnect issues
CONFIG_CLOCK_CONTROL_NRF_K32SRC_RC=y
CONFIG_CLOCK_CONTROL_NRF_K32SRC_250PPM=y

CONFIG_USE_DT_CODE_PARTITION=y
CONFIG_BUILD_OUTPUT_UF2=y

CONFIG_MPU_ALLOW_FLASH_WRITE=y
CONFIG_NVS=y
CONFIG_SETTINGS_NVS=y
CONFIG_FLASH=y
CONFIG_FLASH_PAGE_LAYOUT=y
CONFIG_FLASH_MAP=y

CONFIG_ZMK_BLE=y
CONFIG_ZMK_USB=y

#CONFIG_LOG=y
#CONFIG_ZMK_USB_LOGGING=y
#CONFIG_ZMK_LOG_LEVEL_DBG=y
#CONFIG_LOG_BUFFER_SIZE=65536
# CONFIG_LOG_STRDUP_BUF_COUNT=160
# CONFIG_I2C_LOG_LEVEL_DBG=y
# CONFIG_SPI_LOG_LEVEL_DBG=y
# CONFIG_DISPLAY_LOG_LEVEL_DBG=y
# CONFIG_LVGL_LOG_LEVEL_DBG=y
# CONFIG_LVGL_USE_DEBUG=y
# CONFIG_SENSOR_LOG_LEVEL_DBG=y
```

## boards/shields/lotus-ble/Kconfig.shield
```kconfig
# Copyright (c) 2022 The ZMK Contributors
# SPDX-License-Identifier: MIT

config SHIELD_LOTUS_BLE_LEFT
    def_bool $(shields_list_contains,lotus_ble_left)

config SHIELD_LOTUS_BLE_RIGHT
    def_bool $(shields_list_contains,lotus_ble_right)
```
